## config/west.yml
```yaml
manifest:
  remotes:
    - name: zmkfirmware
      url-base: https://github.com/zmkfirmware
    - name: sfletche132
      url-base: https://github.com/Sfletche132
  projects:
    - name: zmk
      remote: zmkfirmware
      revision: main
      import: app/west.yml
    - name: custom-zmk-animation
      remote: sfletche132
      revision: hud
  self:
    path: config
```
